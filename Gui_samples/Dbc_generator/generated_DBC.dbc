VERSION
NS_ :

BS_:

BU_ Hybrid

BO_ 0x536 Motor: 8 Hybrid
 SG_ signal_crc : 0|8@1+ (1,0) [0|1887] "m/s" Batt_48
 SG_ signal_ctr : 8|4@1+ (1,0) [125|550] "None" Batt_48

BO_ 0x520 Airbag: 8 Hybrid
 SG_ signal_on : 0|4@1+ (0.2,0) [50|500] "Watt" Batt_48
 SG_ AB_deaktiv : 4|4@1- (1,-25) [-16|16] "None" Batt_48
